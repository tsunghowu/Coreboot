## coreboot/src/mainboard/adlink/Kconfig
```kconfig
if VENDOR_ADLINK

comment "see under vendor LiPPERT"
# any further boards will then be ADLINK

choice
	prompt "Mainboard model"
config BOARD_ADLINK_EXPRESS_HL
	bool "Express-HL(Haswell)"

endchoice

source "src/mainboard/adlink/express-hl/Kconfig"

config MAINBOARD_VENDOR
	string
	default "ADLINK"

endif # VENDOR_ADLINK
```

## coreboot/src/mainboard/adlink/express-hl/Kconfig
```kconfig
if BOARD_ADLINK_EXPRESS_HL

config BOARD_SPECIFIC_OPTIONS # dummy
	def_bool y
	select CPU_INTEL_SOCKET_RPGA989
	select NORTHBRIDGE_INTEL_FSP_HASWELL
	select SOUTHBRIDGE_INTEL_FSP_LYNXPOINT
	select BOARD_ROMSIZE_KB_8192
	select HAVE_ACPI_TABLES
	select HAVE_OPTION_TABLE
	select HAVE_ACPI_RESUME
	select HAVE_FSP_BIN
	select SUPERIO_NUVOTON_NCT5104D
	select HAVE_SMI_HANDLER
	select MAINBOARD_HAS_CHROMEOS
	select MAINBOARD_HAS_NATIVE_VGA_INIT
	select MONOTONIC_TIMER_MSR
	select SERIRQ_CONTINUOUS_MODE

config MAINBOARD_DIR
	string
	default adlink/express-hl

config MAINBOARD_PART_NUMBER
	string
	default "EXPRESS-HL"

config MMCONF_BASE_ADDRESS
	hex
	default 0xf0000000	# set to match FSP

config MRC_CACHE_LOC
	hex "Fast Boot Data Cache location in CBFS"
	default 0xfff00000	# set to match FSP
	
config IRQ_SLOT_COUNT
	int
	default 18

config MAX_CPUS
	int
	default 16

config VGA_BIOS_FILE
	string
	default "pci8086,0406.rom"

config HAVE_IFD_BIN
	bool
	default n

config HAVE_ME_BIN
	bool
	default n

endif # BOARD_ADLINK_EXPRESS_HL
```

## coreboot/src/mainboard/new_vendor/Kconfig
```kconfig
if VENDOR_NEW_VENDOR

choice
	prompt "Mainboard model"

config BOARD_NEW_VENDOR_BOARD
	bool "CHW Cougar Canyon 2 CRB"

config BOARD_ADLINK_EXPRESS_HL
	bool "CHW Adlink Express-HL"
endchoice

source "src/mainboard/new_vendor/new_vendor_board/Kconfig"
source "src/mainboard/new_vendor/express-hl/Kconfig"

config MAINBOARD_VENDOR
	string
	default "Chw_mainboard_vendor"

endif # VENDOR_NEW_VENDOR
```

## coreboot/src/mainboard/new_vendor/express-hl/Kconfig
```kconfig
if BOARD_ADLINK_EXPRESS_HL

config BOARD_SPECIFIC_OPTIONS # dummy
	def_bool y
	select CPU_INTEL_SOCKET_RPGA989
	select NORTHBRIDGE_INTEL_FSP_HASWELL
	select SOUTHBRIDGE_INTEL_FSP_LYNXPOINT
	select BOARD_ROMSIZE_KB_8192
	select HAVE_ACPI_TABLES
	select HAVE_OPTION_TABLE
	select MMCONF_SUPPORT
	select HAVE_ACPI_RESUME
	select HAVE_SMI_HANDLER
	select MAINBOARD_HAS_CHROMEOS
	select MAINBOARD_HAS_NATIVE_VGA_INIT
	select MONOTONIC_TIMER_MSR
	select VGA

config MAINBOARD_DIR
	string
	default new_vendor/express-hl

config MAINBOARD_PART_NUMBER
	string
	default "HASWELL PLATFROM"

config MMCONF_BASE_ADDRESS
	hex
	default 0xf8000000	# set to match FSP

config IRQ_SLOT_COUNT
	int
	default 18

config MAX_CPUS
	int
	default 16

config SMBIOS_SYSTEM_ENCLOSURE_TYPE
	hex
	default 0x09	# This is a mobile platform

config UDELAY_LAPIC_FIXED_FSB
	int
	default 100

config VIRTUAL_ROM_SIZE
	hex
	default 0x1000000

if HAVE_FSP_BIN

config VGA_BIOS
	bool
	default y

config VGA_BIOS_FILE
	string
	default "pci8086,0166.rom"

config VGA_BIOS_ID
	string
	default "8086,0166"


endif # HAVE_FSP_BIN

endif # BOARD_NEW_VENDOR_BOARD
```

## coreboot/src/mainboard/new_vendor/new_vendor_board/Kconfig
```kconfig
if BOARD_NEW_VENDOR_BOARD

config BOARD_SPECIFIC_OPTIONS # dummy
	def_bool y
	select CPU_INTEL_SOCKET_RPGA989
	select NORTHBRIDGE_INTEL_FSP_IVYBRIDGE
	select SOUTHBRIDGE_INTEL_FSP_BD82X6X
	select BOARD_ROMSIZE_KB_8192
	select HAVE_ACPI_TABLES
	select HAVE_OPTION_TABLE
	select MMCONF_SUPPORT
	#<CHW+> select SUPERIO_SMSC_SIO1007
	select SUPERIO_WINBOND_W83627DHG		#<CHW+>
	select ENABLE_VMX
	select EARLY_CBMEM_INIT
	select BROKEN_CAR_MIGRATE
	select VGA
	select MONOTONIC_TIMER_MSR				#<CHW+>
#	select DYNAMIC_CBMEM					#<CHW+>

config MAINBOARD_DIR
	string
	default new_vendor/new_vendor_board

config MAINBOARD_PART_NUMBER
	string
	default "CHW Cougar Canyon 2 Trail"

config MMCONF_BASE_ADDRESS
	hex
	default 0xf8000000	# set to match FSP

config IRQ_SLOT_COUNT
	int
	default 18

config MAX_CPUS
	int
	default 16

config SMBIOS_SYSTEM_ENCLOSURE_TYPE
	hex
	default 0x09	# This is a mobile platform

config UDELAY_LAPIC_FIXED_FSB
	int
	default 100

config VIRTUAL_ROM_SIZE
	hex
	default 0x1000000

if HAVE_FSP_BIN

config VGA_BIOS
	bool
	default y

config VGA_BIOS_FILE
	string
	default "../intel/mainboard/intel/cougar_canyon2/vbios/snm_2170.dat"

config VGA_BIOS_ID
	string
	default "8086,0166"


endif # HAVE_FSP_BIN

endif # BOARD_NEW_VENDOR_BOARD
```

## coreboot/src/northbridge/intel/fsp_haswell/Kconfig
```kconfig
##
## This file is part of the coreboot project.
##
## Copyright (C) 2010 Google Inc.
##
## This program is free software; you can redistribute it and/or modify
## it under the terms of the GNU General Public License as published by
## the Free Software Foundation; version 2 of the License.
##
## This program is distributed in the hope that it will be useful,
## but WITHOUT ANY WARRANTY; without even the implied warranty of
## MERCHANTABILITY or FITNESS FOR A PARTICULAR PURPOSE.  See the
## GNU General Public License for more details.
##
## You should have received a copy of the GNU General Public License
## along with this program; if not, write to the Free Software
## Foundation, Inc., 51 Franklin St, Fifth Floor, Boston, MA 02110-1301 USA
##

config NORTHBRIDGE_INTEL_FSP_HASWELL
	bool
	select CACHE_MRC_BIN
	select CPU_INTEL_FSP_HASWELL
	select REQUIRES_BLOB
	select MMCONF_SUPPORT
	select MMCONF_SUPPORT_DEFAULT

if NORTHBRIDGE_INTEL_FSP_HASWELL

config BOOTBLOCK_NORTHBRIDGE_INIT
	string
	default "northbridge/intel/fsp_haswell/bootblock.c"
	
config VGA_BIOS_ID
	string
	default "8086,0406"
	help
	  This is the default PCI ID for the sandybridge/ivybridge graphics
	  devices.  This string names the vbios ROM in cbfs.  The following
	  PCI IDs will be remapped to load this ROM:
	  0x80860102, 0x8086010a, 0x80860112, 0x80860116
	  0x80860122, 0x80860126, 0x80860166

config CBFS_SIZE
	hex "Size of CBFS filesystem in ROM"
	default 0x100000
	help
	  On Sandybridge and Ivybridge systems the firmware image may
	  have to store a lot more than just coreboot, including:
	   - a firmware descriptor
	   - Intel Management Engine firmware
	  This option specifies the maximum size of the CBFS portion in the
	  firmware image.

config PRE_GRAPHICS_DELAY
	int "Graphics initialization delay in ms"
	default 0
	help
	  On some systems, coreboot boots so fast that connected monitors
	  (mostly TVs) won't be able to wake up fast enough to talk to the
	  VBIOS. On those systems we need to wait for a bit before executing
	  the VBIOS.
	  
# Ivybridge Specific FSP Kconfig
source src/northbridge/intel/fsp_haswell/fsp/Kconfig

endif
```
